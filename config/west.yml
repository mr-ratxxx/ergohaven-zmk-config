## config/west.yml
```yaml
manifest:
  remotes:
    - name: mr-ratxxx
      url-base: https://github.com/mr-ratxxx
  projects:
    - name: ergohaven-zmk
      remote: mr-ratxxx
      revision: zmk-main
      import: config/west.yml
  self:
    path: config
```
